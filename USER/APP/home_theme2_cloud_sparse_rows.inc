/* Generated by Tools/generate_home_cloud_sparse_rows.py. */
/* Do not edit manually; row offsets are relative to each PSRAM image payload. */

static const home_theme2_cloud_row_meta_t s_cloud_rows_a_1_rows[] = {
    {0U, 0U, 0U},
    {0U, 0U, 0U},
    {0U, 0U, 0U},
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    {39723U, 95U, 0U},
};

static const home_theme2_cloud_segment_meta_t s_cloud_rows_a_1_segments[] = {
    {0U, 90U, 5U},
    {0U, 86U, 13U},
    {13U, 106U, 9U},
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    {0U, 3U, 194U},
};

static const home_theme2_cloud_row_meta_t s_cloud_rows_a_2_rows[] = {
    {0U, 0U, 0U},
    {0U, 0U, 0U},
    {0U, 0U, 0U},
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    {39363U, 94U, 0U},
};

static const home_theme2_cloud_segment_meta_t s_cloud_rows_a_2_segments[] = {
    {0U, 89U, 7U},
    {0U, 86U, 14U},
    {14U, 105U, 11U},
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    {0U, 3U, 194U},
};

static const home_theme2_cloud_row_meta_t s_cloud_rows_a_3_rows[] = {
    {0U, 0U, 0U},
    {0U, 0U, 0U},
    {0U, 0U, 0U},
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    {39363U, 94U, 0U},
};

static const home_theme2_cloud_segment_meta_t s_cloud_rows_a_3_segments[] = {
    {0U, 89U, 7U},
    {0U, 86U, 14U},
    {14U, 105U, 11U},
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    {0U, 3U, 194U},
};

static const home_theme2_cloud_row_meta_t s_cloud_rows_b_1_rows[] = {
    {0U, 0U, 0U},
    {0U, 0U, 1U},
    {30U, 1U, 1U},
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    {23211U, 82U, 0U},
};

static const home_theme2_cloud_segment_meta_t s_cloud_rows_b_1_segments[] = {
    {0U, 54U, 10U},
    {0U, 51U, 15U},
    {0U, 50U, 23U},
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    {0U, 4U, 128U},
};

static const home_theme2_cloud_row_meta_t s_cloud_rows_b_2_rows[] = {
    {0U, 0U, 0U},
    {0U, 0U, 1U},
    {33U, 1U, 1U},
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    {23400U, 83U, 0U},
};

static const home_theme2_cloud_segment_meta_t s_cloud_rows_b_2_segments[] = {
    {0U, 53U, 11U},
    {0U, 51U, 15U},
    {0U, 49U, 24U},
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    {0U, 3U, 129U},
};

static const home_theme2_cloud_row_meta_t s_cloud_rows_b_3_rows[] = {
    {0U, 0U, 0U},
    {0U, 0U, 1U},
    {33U, 1U, 1U},
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    {23400U, 83U, 0U},
};

static const home_theme2_cloud_segment_meta_t s_cloud_rows_b_3_segments[] = {
    {0U, 53U, 11U},
    {0U, 51U, 15U},
    {0U, 49U, 24U},
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    {0U, 3U, 129U},
};

static const home_theme2_cloud_row_meta_t s_cloud_rows_c_1_rows[] = {
    {0U, 0U, 0U},
    {0U, 0U, 1U},
    {15U, 1U, 1U},
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    {44460U, 111U, 0U},
};

static const home_theme2_cloud_segment_meta_t s_cloud_rows_c_1_segments[] = {
    {0U, 83U, 5U},
    {0U, 79U, 15U},
    {0U, 76U, 20U},
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    {0U, 9U, 186U},
};

static const home_theme2_cloud_row_meta_t s_cloud_rows_c_2_rows[] = {
    {0U, 0U, 0U},
    {0U, 0U, 1U},
    {24U, 1U, 1U},
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    {44550U, 111U, 0U},
};

static const home_theme2_cloud_segment_meta_t s_cloud_rows_c_2_segments[] = {
    {0U, 82U, 8U},
    {0U, 78U, 16U},
    {0U, 76U, 21U},
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    {0U, 10U, 185U},
};

static const home_theme2_cloud_row_meta_t s_cloud_rows_c_3_rows[] = {
    {0U, 0U, 0U},
    {0U, 0U, 1U},
    {24U, 1U, 1U},
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    {44550U, 111U, 0U},
};

static const home_theme2_cloud_segment_meta_t s_cloud_rows_c_3_segments[] = {
    {0U, 82U, 8U},
    {0U, 78U, 16U},
    {0U, 76U, 21U},
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    {0U, 10U, 185U},
};

static const home_theme2_cloud_row_meta_t s_cloud_blend_rows_a_1_2_rows[] = {
    {0U, 0U, 0U},
    {0U, 0U, 0U},
    {0U, 0U, 0U},
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    {39816U, 95U, 0U},
};

static const home_theme2_cloud_segment_meta_t s_cloud_blend_rows_a_1_2_segments[] = {
    {0U, 90U, 5U},
    {0U, 86U, 13U},
    {13U, 106U, 9U},
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    {0U, 3U, 194U},
};

static const home_theme2_cloud_row_meta_t s_cloud_blend_rows_a_1_3_rows[] = {
    {0U, 0U, 0U},
    {0U, 0U, 0U},
    {0U, 0U, 0U},
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    {39816U, 95U, 0U},
};

static const home_theme2_cloud_segment_meta_t s_cloud_blend_rows_a_1_3_segments[] = {
    {0U, 90U, 5U},
    {0U, 86U, 13U},
    {13U, 106U, 9U},
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    {0U, 3U, 194U},
};

static const home_theme2_cloud_row_meta_t s_cloud_blend_rows_a_2_3_rows[] = {
    {0U, 0U, 0U},
    {0U, 0U, 0U},
    {0U, 0U, 0U},
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    {39363U, 94U, 0U},
};

static const home_theme2_cloud_segment_meta_t s_cloud_blend_rows_a_2_3_segments[] = {
    {0U, 89U, 7U},
    {0U, 86U, 14U},
    {14U, 105U, 11U},
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    {0U, 3U, 194U},
};

static const home_theme2_cloud_row_meta_t s_cloud_blend_rows_b_1_2_rows[] = {
    {0U, 0U, 0U},
    {0U, 0U, 1U},
    {33U, 1U, 1U},
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    {23424U, 83U, 0U},
};

static const home_theme2_cloud_segment_meta_t s_cloud_blend_rows_b_1_2_segments[] = {
    {0U, 53U, 11U},
    {0U, 51U, 15U},
    {0U, 49U, 24U},
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    {0U, 3U, 129U},
};

static const home_theme2_cloud_row_meta_t s_cloud_blend_rows_b_1_3_rows[] = {
    {0U, 0U, 0U},
    {0U, 0U, 1U},
    {33U, 1U, 1U},
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    {23424U, 83U, 0U},
};

static const home_theme2_cloud_segment_meta_t s_cloud_blend_rows_b_1_3_segments[] = {
    {0U, 53U, 11U},
    {0U, 51U, 15U},
    {0U, 49U, 24U},
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    {0U, 3U, 129U},
};

static const home_theme2_cloud_row_meta_t s_cloud_blend_rows_b_2_3_rows[] = {
    {0U, 0U, 0U},
    {0U, 0U, 1U},
    {33U, 1U, 1U},
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    {23400U, 83U, 0U},
};

static const home_theme2_cloud_segment_meta_t s_cloud_blend_rows_b_2_3_segments[] = {
    {0U, 53U, 11U},
    {0U, 51U, 15U},
    {0U, 49U, 24U},
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    {0U, 3U, 129U},
};

static const home_theme2_cloud_row_meta_t s_cloud_blend_rows_c_1_2_rows[] = {
    {0U, 0U, 0U},
    {0U, 0U, 1U},
    {24U, 1U, 1U},
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    {44559U, 111U, 0U},
};

static const home_theme2_cloud_segment_meta_t s_cloud_blend_rows_c_1_2_segments[] = {
    {0U, 82U, 8U},
    {0U, 78U, 16U},
    {0U, 76U, 21U},
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    {0U, 9U, 186U},
};

static const home_theme2_cloud_row_meta_t s_cloud_blend_rows_c_1_3_rows[] = {
    {0U, 0U, 0U},
    {0U, 0U, 1U},
    {24U, 1U, 1U},
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    {44559U, 111U, 0U},
};

static const home_theme2_cloud_segment_meta_t s_cloud_blend_rows_c_1_3_segments[] = {
    {0U, 82U, 8U},
    {0U, 78U, 16U},
    {0U, 76U, 21U},
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    {0U, 9U, 186U},
};

static const home_theme2_cloud_row_meta_t s_cloud_blend_rows_c_2_3_rows[] = {
    {0U, 0U, 0U},
    {0U, 0U, 1U},
    {24U, 1U, 1U},
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    {44550U, 111U, 0U},
};

static const home_theme2_cloud_segment_meta_t s_cloud_blend_rows_c_2_3_segments[] = {
    {0U, 82U, 8U},
    {0U, 78U, 16U},
    {0U, 76U, 21U},
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    {0U, 10U, 185U},
};

static const home_theme2_cloud_sparse_resource_t s_cloud_sparse_resources[HOME_THEME2_CLOUD_SHAPE_COUNT][HOME_THEME2_CLOUD_STATE_COUNT] = {
    {{s_cloud_rows_a_1_rows, s_cloud_rows_a_1_segments, 39723U, 229U, 112U}, {s_cloud_rows_a_2_rows, s_cloud_rows_a_2_segments, 39363U, 229U, 112U}, {s_cloud_rows_a_3_rows, s_cloud_rows_a_3_segments, 39363U, 229U, 112U}},
    {{s_cloud_rows_b_1_rows, s_cloud_rows_b_1_segments, 23211U, 156U, 76U}, {s_cloud_rows_b_2_rows, s_cloud_rows_b_2_segments, 23400U, 156U, 76U}, {s_cloud_rows_b_3_rows, s_cloud_rows_b_3_segments, 23400U, 156U, 76U}},
    {{s_cloud_rows_c_1_rows, s_cloud_rows_c_1_segments, 44460U, 229U, 112U}, {s_cloud_rows_c_2_rows, s_cloud_rows_c_2_segments, 44550U, 229U, 112U}, {s_cloud_rows_c_3_rows, s_cloud_rows_c_3_segments, 44550U, 229U, 112U}},
};

static const home_theme2_cloud_sparse_resource_t s_cloud_blend_resources[HOME_THEME2_CLOUD_SHAPE_COUNT][HOME_THEME2_CLOUD_STATE_COUNT][HOME_THEME2_CLOUD_STATE_COUNT] = {
    {
        {{s_cloud_rows_a_1_rows, s_cloud_rows_a_1_segments, 39723U, 229U, 112U}, {s_cloud_blend_rows_a_1_2_rows, s_cloud_blend_rows_a_1_2_segments, 39816U, 229U, 112U}, {s_cloud_blend_rows_a_1_3_rows, s_cloud_blend_rows_a_1_3_segments, 39816U, 229U, 112U}},
        {{s_cloud_blend_rows_a_1_2_rows, s_cloud_blend_rows_a_1_2_segments, 39816U, 229U, 112U}, {s_cloud_rows_a_2_rows, s_cloud_rows_a_2_segments, 39363U, 229U, 112U}, {s_cloud_blend_rows_a_2_3_rows, s_cloud_blend_rows_a_2_3_segments, 39363U, 229U, 112U}},
        {{s_cloud_blend_rows_a_1_3_rows, s_cloud_blend_rows_a_1_3_segments, 39816U, 229U, 112U}, {s_cloud_blend_rows_a_2_3_rows, s_cloud_blend_rows_a_2_3_segments, 39363U, 229U, 112U}, {s_cloud_rows_a_3_rows, s_cloud_rows_a_3_segments, 39363U, 229U, 112U}},
    },
    {
        {{s_cloud_rows_b_1_rows, s_cloud_rows_b_1_segments, 23211U, 156U, 76U}, {s_cloud_blend_rows_b_1_2_rows, s_cloud_blend_rows_b_1_2_segments, 23424U, 156U, 76U}, {s_cloud_blend_rows_b_1_3_rows, s_cloud_blend_rows_b_1_3_segments, 23424U, 156U, 76U}},
        {{s_cloud_blend_rows_b_1_2_rows, s_cloud_blend_rows_b_1_2_segments, 23424U, 156U, 76U}, {s_cloud_rows_b_2_rows, s_cloud_rows_b_2_segments, 23400U, 156U, 76U}, {s_cloud_blend_rows_b_2_3_rows, s_cloud_blend_rows_b_2_3_segments, 23400U, 156U, 76U}},
        {{s_cloud_blend_rows_b_1_3_rows, s_cloud_blend_rows_b_1_3_segments, 23424U, 156U, 76U}, {s_cloud_blend_rows_b_2_3_rows, s_cloud_blend_rows_b_2_3_segments, 23400U, 156U, 76U}, {s_cloud_rows_b_3_rows, s_cloud_rows_b_3_segments, 23400U, 156U, 76U}},
    },
    {
        {{s_cloud_rows_c_1_rows, s_cloud_rows_c_1_segments, 44460U, 229U, 112U}, {s_cloud_blend_rows_c_1_2_rows, s_cloud_blend_rows_c_1_2_segments, 44559U, 229U, 112U}, {s_cloud_blend_rows_c_1_3_rows, s_cloud_blend_rows_c_1_3_segments, 44559U, 229U, 112U}},
        {{s_cloud_blend_rows_c_1_2_rows, s_cloud_blend_rows_c_1_2_segments, 44559U, 229U, 112U}, {s_cloud_rows_c_2_rows, s_cloud_rows_c_2_segments, 44550U, 229U, 112U}, {s_cloud_blend_rows_c_2_3_rows, s_cloud_blend_rows_c_2_3_segments, 44550U, 229U, 112U}},
        {{s_cloud_blend_rows_c_1_3_rows, s_cloud_blend_rows_c_1_3_segments, 44559U, 229U, 112U}, {s_cloud_blend_rows_c_2_3_rows, s_cloud_blend_rows_c_2_3_segments, 44550U, 229U, 112U}, {s_cloud_rows_c_3_rows, s_cloud_rows_c_3_segments, 44550U, 229U, 112U}},
    },
};

static const uint32_t s_cloud_blend_slot_payload_sizes[HOME_THEME2_CLOUD_SHAPE_COUNT] = {
    39816U,
    23424U,
    44559U,
};
